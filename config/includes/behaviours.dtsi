/ {

    behaviors {
        nav_word: nav_word {
            compatible = "zmk,behavior-caps-word";
            label = "NAV_WORD";
            #binding-cells = <0>;
            layers = <NAV>;
            continue-list = <
                LEFT DOWN UP RIGHT
                PG_UP PG_DN
            >;
        };
    };
};
